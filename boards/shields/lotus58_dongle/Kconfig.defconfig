## boards/shields/lotus58_dongle/Kconfig.defconfig
```kconfig
# Copyright (c) 2024 The ZMK Contributors
# SPDX-License-Identifier: MIT
if SHIELD_LOTUS58_DONGLE

config ZMK_KEYBOARD_NAME
    default "Lotus58"

config ZMK_SPLIT_ROLE_CENTRAL
    default y

config ZMK_SPLIT
    default y

# 左右两半
config ZMK_SPLIT_BLE_CENTRAL_PERIPHERALS
    default 2

# 2 个外设 + 1 个主机，留出多设备切换余量
config BT_MAX_CONN
    default 7

config BT_MAX_PAIRED
    default 7

# dongle 上有 0.96" 128x64 OLED
if ZMK_DISPLAY
config I2C
    default y
config SSD1306
    default y
endif # ZMK_DISPLAY

if LVGL
config LV_Z_VDB_SIZE
    default 64
config LV_DPI_DEF
    default 148
config LV_Z_BITS_PER_PIXEL
    default 1
choice LV_COLOR_DEPTH
    default LV_COLOR_DEPTH_1
endchoice
endif # LVGL

endif
```
